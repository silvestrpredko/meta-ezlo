## conf/layer.conf
```bitbake
# We have a conf and classes directory, add to BBPATH
BBPATH .= ":${LAYERDIR}"

# We have recipes-* directories, add to BBFILES
BBFILES += "${LAYERDIR}/recipes-*/*/*.bb \
            ${LAYERDIR}/recipes-*/*/*.bbappend \
            ${LAYERDIR}/images/*.bb \
"

BBFILE_COLLECTIONS += "meta-ezlo"
BBFILE_PATTERN_meta-ezlo = "^${LAYERDIR}/"
BBFILE_PRIORITY_meta-ezlo = "6"
LAYERSERIES_COMPAT_meta-ezlo = "thud sumo rocko warrior"
```

## conf/machine/sun8i.conf
```bitbake
#@TYPE: Machine
#@NAME: orange-pi-plus2
#@DESCRIPTION: Machine configuration for the orange-pi-plus2, base on allwinner H3 CPU

require conf/machine/include/sun8i.inc

XSERVER_append = " xserver-xorg-extension-glx"

PREFERRED_PROVIDER_virtual/kernel = "linux-armbian"
PREFERRED_PROVIDER_virtual/bootloader = "u-boot-armbian"

SUNXI_FEX_FILE = "orangepiplus2e.fex"
UBOOT_MACHINE = "orangepi_plus2e_defconfig"
```
